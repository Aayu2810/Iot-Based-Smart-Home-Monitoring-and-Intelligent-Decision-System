/**
 * =========================================================================
 * Smart Home Monitoring System — Dijkstra Pathfinder (dijkstra_algorithm.cpp)
 * =========================================================================
 */

#include "dijkstra_algorithm.h"

// --- MinHeap Implementation ---
MinHeap::MinHeap() {
  initialize();
}

void MinHeap::initialize() {
  heap_size = 0;
}

void MinHeap::siftUp(int i) {
  while (i > 0 && heap[(i-1)/2].cost > heap[i].cost) {
    MinHeapNode temp = heap[(i-1)/2];
    heap[(i-1)/2] = heap[i];
    heap[i] = temp;
    i = (i-1)/2;
  }
}

void MinHeap::siftDown(int i) {
  int minIndex = i;
  int l = 2 * i + 1;
  int r = 2 * i + 2;
  
  if (l < heap_size && heap[l].cost < heap[minIndex].cost) minIndex = l;
  if (r < heap_size && heap[r].cost < heap[minIndex].cost) minIndex = r;
  
  if (i != minIndex) {
    MinHeapNode temp = heap[i];
    heap[i] = heap[minIndex];
    heap[minIndex] = temp;
    siftDown(minIndex);
  }
}

void MinHeap::insert(float cost, int v) {
  if (heap_size < NUM_ZONES * 2) {
    heap[heap_size].cost = cost;
    heap[heap_size].vertex = v;
    heap_size++;
    siftUp(heap_size - 1);
  }
}

MinHeapNode MinHeap::extractMin() {
  MinHeapNode root = heap[0];
  if (heap_size > 0) {
    heap[0] = heap[heap_size - 1];
    heap_size--;
    siftDown(0);
  }
  return root;
}

bool MinHeap::isEmpty() const {
  return heap_size == 0;
}


// --- Dijkstra Pathfinder Implementation ---
DijkstraAlgorithm::DijkstraAlgorithm() {}

float DijkstraAlgorithm::computeSafetyCost(const GraphEngine& graph, int i, int j) {
  // R_avg = Mean risk score across the edge vertices
  float r_i = graph.getZone(i).risk_score;
  float r_j = graph.getZone(j).risk_score;
  float R_avg = (r_i + r_j) / 2.0f;
  
  // W_safe = 1 / (1 - R_avg + epsilon) (Subject: DAA)
  float denom = 1.0f - R_avg + EPSILON;
  return 1.0f / denom;
}

DijkstraResult DijkstraAlgorithm::run(const GraphEngine& graph, int source, int exit_zone) {
  unsigned long start_time_us = micros();
  DijkstraResult result;
  result.path_length = 0;
  result.total_cost = 0.0f;
  result.path_differs_from_bfs = false;

  bool visited[NUM_ZONES];
  for (int i = 0; i < NUM_ZONES; i++) {
    result.dist[i] = 999999.0f;
    result.prev[i] = -1;
    visited[i] = false;
    result.path[i] = -1;
  }

  result.dist[source] = 0.0f;
  min_heap.initialize();
  min_heap.insert(0.0f, source);

  while (!min_heap.isEmpty()) {
    MinHeapNode node = min_heap.extractMin();
    int u = node.vertex;

    if (u == exit_zone) break;
    if (visited[u]) continue;
    visited[u] = true;

    for (int v = 0; v < NUM_ZONES; v++) {
      if (graph.hasEdge(u, v) && !visited[v]) {
        float cost = computeSafetyCost(graph, u, v);
        float alt = result.dist[u] + cost;
        if (alt < result.dist[v]) {
          result.dist[v] = alt;
          result.prev[v] = u;
          min_heap.insert(alt, v);
        }
      }
    }
  }

  // Path reconstruction
  int route[NUM_ZONES];
  int count = 0;
  int curr = exit_zone;
  
  if (result.prev[curr] != -1 || curr == source) {
    while (curr != -1) {
      route[count++] = curr;
      curr = result.prev[curr];
    }
    
    // Reverse route to match source-to-exit flow
    result.path_length = count;
    for (int i = 0; i < count; i++) {
      result.path[i] = route[count - 1 - i];
    }
    result.total_cost = result.dist[exit_zone];
  }

  result.execution_time_us = micros() - start_time_us;
  return result;
}

void DijkstraAlgorithm::compareWithBFS(DijkstraResult& dijkstra, const BFSResult& bfs, int source, int exit_zone) {
  // Trace path generated by BFS via checking parent array from exit back to source
  int bfs_path[NUM_ZONES];
  int bfs_route[NUM_ZONES];
  int bfs_count = 0;
  int curr = exit_zone;

  bfs_route[bfs_count++] = curr;
  while (curr != source && bfs.parent[curr] != -1) {
    curr = bfs.parent[curr];
    bfs_route[bfs_count++] = curr;
  }

  // Reverse BFS path
  for (int i = 0; i < bfs_count; i++) {
    bfs_path[i] = bfs_route[bfs_count - 1 - i];
  }

  // Compare arrays
  if (bfs_count != dijkstra.path_length) {
    dijkstra.path_differs_from_bfs = true;
  } else {
    for (int i = 0; i < bfs_count; i++) {
      if (bfs_path[i] != dijkstra.path[i]) {
        dijkstra.path_differs_from_bfs = true;
        break;
      }
    }
  }

  if (dijkstra.path_differs_from_bfs) {
    Serial.println("[Pathfinder Audit] NOTICE: Dijkstra hazard-aware path differs from standard min-hop BFS route!");
    Serial.print("  BFS Route: ");
    for (int i = 0; i < bfs_count; i++) {
      Serial.printf("%d ", bfs_path[i]);
      if (i < bfs_count - 1) Serial.print("-> ");
    }
    Serial.print("\n  Dijkstra Safety Route: ");
    for (int i = 0; i < dijkstra.path_length; i++) {
      Serial.printf("%d ", dijkstra.path[i]);
      if (i < dijkstra.path_length - 1) Serial.print("-> ");
    }
    Serial.println();
  }
}

void DijkstraAlgorithm::printDijkstraResult(const DijkstraResult& result, const GraphEngine& graph) const {
  Serial.println("================ DIJKSTRA ROUTE PATH ==================");
  if (result.path_length == 0) {
    Serial.println("  CRITICAL PATH FAILURE: Destination physically blocked / unreachable!");
  } else {
    Serial.print("  Safe Evacuation Path: ");
    for (int i = 0; i < result.path_length; i++) {
      Serial.printf("[%s]", graph.getZone(result.path[i]).name);
      if (i < result.path_length - 1) Serial.print(" ===> ");
    }
    Serial.printf("\n  Dynamic Safe Path Cost Metric: %.4f | Pathfinder Time: %lu us\n",
                  result.total_cost, result.execution_time_us);
  }
  Serial.println("=========================================================");
}
